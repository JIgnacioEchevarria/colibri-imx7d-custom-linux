## layers/meta-toradex-nxp/conf/machine/include/apalis-imx6.inc
```bitbake
IMAGE_CLASSES:append = " image_type_tezi"
IMAGE_FSTYPES:append = " teziimg"
# The payload offsets are given in number of 512 byte blocks.
OFFSET_BOOTROM_PAYLOAD = "2"
OFFSET_SPL_PAYLOAD = "138"
TORADEX_PRODUCT_IDS = "0027 0028 0029 0035 0082 0083 0084 0085"

MACHINEOVERRIDES =. "tdx:"

MACHINE_NAME = "Apalis-iMX6"

# with kernel 6.5 the device trees were moved to vendor subdirs
KERNEL_DTB_PREFIX = "nxp/imx/"
KERNEL_DTB_PREFIX:preempt-rt = "nxp/imx/"
KERNEL_DTB_PREFIX:use-nxp-bsp = ""
KERNEL_DEVICETREE:apalis-imx6 = " \
    ${KERNEL_DTB_PREFIX}imx6q-apalis-eval.dtb \
    ${KERNEL_DTB_PREFIX}imx6q-apalis-eval-v1.2.dtb \
    ${KERNEL_DTB_PREFIX}imx6q-apalis-ixora.dtb \
    ${KERNEL_DTB_PREFIX}imx6q-apalis-ixora-v1.1.dtb \
    ${KERNEL_DTB_PREFIX}imx6q-apalis-ixora-v1.2.dtb \
    ${KERNEL_DTB_PREFIX}imx6q-apalis-v1.2-eval.dtb \
    ${KERNEL_DTB_PREFIX}imx6q-apalis-v1.2-eval-v1.2.dtb \
    ${KERNEL_DTB_PREFIX}imx6q-apalis-v1.2-ixora.dtb \
    ${KERNEL_DTB_PREFIX}imx6q-apalis-v1.2-ixora-v1.1.dtb \
    ${KERNEL_DTB_PREFIX}imx6q-apalis-v1.2-ixora-v1.2.dtb \
"
TEZI_EXTERNAL_KERNEL_DEVICETREE_BOOT:use-mainline-bsp = " \
    apalis-imx6_hdmi_overlay.dtbo \
    apalis-imx6_spi1_spidev_overlay.dtbo \
    apalis-imx6_spi2_spidev_overlay.dtbo \
"
TEZI_EXTERNAL_KERNEL_DEVICETREE_BOOT = ""

PREFERRED_PROVIDER_virtual/kernel = "linux-toradex"
PREFERRED_PROVIDER_virtual/kernel:preempt-rt = "linux-toradex"
PREFERRED_PROVIDER_virtual/kernel:use-mainline-bsp = "linux-toradex-upstream"
PREFERRED_VERSION_linux-toradex-upstream = "6.6%"
PREFERRED_PROVIDER_virtual/kernel:use-mainline-bsp:preempt-rt = "linux-toradex-upstream-rt"
PREFERRED_VERSION_linux-toradex-upstream-rt = "6.6%"
PREFERRED_PROVIDER_virtual/dtb:use-mainline-bsp = "device-tree-overlays-mainline"

IMX_DEFAULT_BOOTLOADER:apalis-imx6 = "u-boot-toradex"
PREFERRED_PROVIDER_u-boot-default-script = "u-boot-distro-boot"
UBOOT_SUFFIX = "img"

MACHINE_FIRMWARE:remove = "firmware-imx-epdc"

UBOOT_DTB_LOADADDRESS:apalis-imx6 = "0x18200000"
UBOOT_DTBO_LOADADDRESS:apalis-imx6 = "0x18300000"
UBOOT_ENTRYPOINT:apalis-imx6 = "0x14200000"
UBOOT_RD_LOADADDRESS:apalis-imx6 = "0x1A400000"
```

## layers/meta-toradex-nxp/conf/machine/include/colibri-imx6.inc
```bitbake
IMAGE_CLASSES:append = " image_type_tezi"
IMAGE_FSTYPES:append = " teziimg"
# The payload offsets are given in number of 512 byte blocks.
OFFSET_BOOTROM_PAYLOAD = "2"
OFFSET_SPL_PAYLOAD = "138"
TORADEX_PRODUCT_IDS = "0014 0015 0016 0017 0077 0078 0079 0080"

MACHINEOVERRIDES =. "tdx:"

MACHINE_NAME = "Colibri-iMX6"

# with kernel 6.5 the device trees were moved to vendor subdirs
KERNEL_DTB_PREFIX = "nxp/imx/"
KERNEL_DTB_PREFIX:preempt-rt = "nxp/imx/"
KERNEL_DTB_PREFIX:use-nxp-bsp = ""
KERNEL_DEVICETREE:colibri-imx6 = " \
    ${KERNEL_DTB_PREFIX}imx6dl-colibri-aster.dtb \
    ${KERNEL_DTB_PREFIX}imx6dl-colibri-eval-v3.dtb \
    ${KERNEL_DTB_PREFIX}imx6dl-colibri-iris.dtb \
    ${KERNEL_DTB_PREFIX}imx6dl-colibri-iris-v2.dtb \
    ${KERNEL_DTB_PREFIX}imx6dl-colibri-v1.2-aster.dtb \
    ${KERNEL_DTB_PREFIX}imx6dl-colibri-v1.2-eval-v3.dtb \
    ${KERNEL_DTB_PREFIX}imx6dl-colibri-v1.2-iris.dtb \
    ${KERNEL_DTB_PREFIX}imx6dl-colibri-v1.2-iris-v2.dtb \
"
TEZI_EXTERNAL_KERNEL_DEVICETREE_BOOT:use-mainline-bsp = " \
    colibri-imx6_vga-640x480_overlay.dtbo \
"
TEZI_EXTERNAL_KERNEL_DEVICETREE_BOOT = ""

PREFERRED_PROVIDER_virtual/kernel = "linux-toradex"
PREFERRED_PROVIDER_virtual/kernel:preempt-rt = "linux-toradex"
PREFERRED_PROVIDER_virtual/kernel:use-mainline-bsp = "linux-toradex-upstream"
PREFERRED_VERSION_linux-toradex-upstream = "6.6%"
PREFERRED_PROVIDER_virtual/kernel:use-mainline-bsp:preempt-rt = "linux-toradex-upstream-rt"
PREFERRED_VERSION_linux-toradex-upstream-rt = "6.6%"
PREFERRED_PROVIDER_virtual/dtb:use-mainline-bsp = "device-tree-overlays-mainline"

IMX_DEFAULT_BOOTLOADER:colibri-imx6 = "u-boot-toradex"
PREFERRED_PROVIDER_u-boot-default-script = "u-boot-distro-boot"
UBOOT_SUFFIX = "img"

MACHINE_FIRMWARE:remove = "firmware-imx-epdc"

UBOOT_DTB_LOADADDRESS:colibri-imx6 = "0x18200000"
UBOOT_DTBO_LOADADDRESS:colibri-imx6 = "0x18300000"
UBOOT_ENTRYPOINT:colibri-imx6 = "0x14200000"
UBOOT_RD_LOADADDRESS:colibri-imx6 = "0x1A400000"
```

## layers/meta-toradex-nxp/conf/machine/include/colibri-imx6ull.inc
```bitbake
IMAGE_CLASSES:append = " image_type_tezi"
IMAGE_FSTYPES:append = " teziimg"
TORADEX_PRODUCT_IDS = "0036 0040 0044 0045"
TORADEX_PRODUCT_IDS[0036] = "imx6ull-colibri-eval-v3.dtb"
TORADEX_PRODUCT_IDS[0040] = "imx6ull-colibri-wifi-eval-v3.dtb"
TORADEX_PRODUCT_IDS[0044] = "imx6ull-colibri-eval-v3.dtb"
TORADEX_PRODUCT_IDS[0045] = "imx6ull-colibri-wifi-eval-v3.dtb"
TORADEX_FLASH_TYPE = "rawnand"

WIC_CREATE_EXTRA_ARGS:append = " --no-fstab-update"

MACHINEOVERRIDES =. "tdx:"

MACHINE_NAME = "Colibri-iMX6ULL"

MACHINE_EXTRA_RRECOMMENDS:append = " mwifiexconf"

# with kernel 6.5 the device trees were moved to vendor subdirs
KERNEL_DTB_PREFIX = "nxp/imx/"
KERNEL_DTB_PREFIX:preempt-rt = "nxp/imx/"
KERNEL_DTB_PREFIX:use-nxp-bsp = ""
KERNEL_DEVICETREE:colibri-imx6ull = " \
    ${KERNEL_DTB_PREFIX}imx6ull-colibri-aster.dtb \
    ${KERNEL_DTB_PREFIX}imx6ull-colibri-eval-v3.dtb \
    ${KERNEL_DTB_PREFIX}imx6ull-colibri-iris.dtb \
    ${KERNEL_DTB_PREFIX}imx6ull-colibri-iris-v2.dtb \
    ${KERNEL_DTB_PREFIX}imx6ull-colibri-wifi-aster.dtb \
    ${KERNEL_DTB_PREFIX}imx6ull-colibri-wifi-eval-v3.dtb \
    ${KERNEL_DTB_PREFIX}imx6ull-colibri-wifi-iris.dtb \
    ${KERNEL_DTB_PREFIX}imx6ull-colibri-wifi-iris-v2.dtb \
"

PREFERRED_PROVIDER_virtual/kernel = "linux-toradex"
PREFERRED_PROVIDER_virtual/kernel:preempt-rt = "linux-toradex"
PREFERRED_PROVIDER_virtual/kernel:use-mainline-bsp = "linux-toradex-upstream"
PREFERRED_VERSION_linux-toradex-upstream = "6.6%"
PREFERRED_PROVIDER_virtual/kernel:use-mainline-bsp:preempt-rt = "linux-toradex-upstream-rt"
PREFERRED_VERSION_linux-toradex-upstream-rt = "6.6%"
PREFERRED_PROVIDER_virtual/dtb:use-mainline-bsp = "device-tree-overlays-mainline"

IMX_DEFAULT_BOOTLOADER:colibri-imx6ull = "u-boot-toradex"
PREFERRED_PROVIDER_u-boot-default-script = "u-boot-distro-boot"

MACHINE_FIRMWARE:remove:use-mainline-bsp = "firmware-imx-vpu-imx6q firmware-imx-vpu-imx6d"

UBOOT_DTB_LOADADDRESS:colibri-imx6ull = "0x88200000"
UBOOT_DTBO_LOADADDRESS:colibri-imx6ull = "0x88300000"
UBOOT_ENTRYPOINT:colibri-imx6ull = "0x84200000"
UBOOT_MAKE_TARGET:colibri-imx6ull = "u-boot-nand.imx"
UBOOT_RD_LOADADDRESS:colibri-imx6ull = "0x8A400000"
```

## layers/meta-toradex-nxp/conf/machine/include/colibri-imx7-emmc.inc
```bitbake
IMAGE_CLASSES:append = " image_type_tezi"
IMAGE_FSTYPES:append = " teziimg"
# The payload offsets are given in number of 512 byte blocks.
OFFSET_BOOTROM_PAYLOAD = "2"
TORADEX_PRODUCT_IDS = "0039"
TORADEX_FLASH_TYPE = "emmc"

MACHINEOVERRIDES =. "tdx:"

MACHINE_NAME = "Colibri-iMX7-eMMC"

# with kernel 6.5 the device trees were moved to vendor subdirs
KERNEL_DTB_PREFIX = "nxp/imx/"
KERNEL_DTB_PREFIX:preempt-rt = "nxp/imx/"
KERNEL_DTB_PREFIX:use-nxp-bsp = ""
KERNEL_DEVICETREE:colibri-imx7-emmc = " \
    ${KERNEL_DTB_PREFIX}imx7d-colibri-emmc-aster.dtb \
    ${KERNEL_DTB_PREFIX}imx7d-colibri-emmc-eval-v3.dtb \
    ${KERNEL_DTB_PREFIX}imx7d-colibri-emmc-iris.dtb \
    ${KERNEL_DTB_PREFIX}imx7d-colibri-emmc-iris-v2.dtb \
"

TEZI_EXTERNAL_KERNEL_DEVICETREE_BOOT:use-mainline-bsp = " \
    colibri-imx7_vga-640x480_overlay.dtbo \
"
TEZI_EXTERNAL_KERNEL_DEVICETREE_BOOT = ""

PREFERRED_PROVIDER_virtual/kernel = "linux-toradex"
PREFERRED_PROVIDER_virtual/kernel:preempt-rt = "linux-toradex"
PREFERRED_PROVIDER_virtual/kernel:use-mainline-bsp = "linux-toradex-upstream"
PREFERRED_VERSION_linux-toradex-upstream = "6.6%"
PREFERRED_PROVIDER_virtual/kernel:use-mainline-bsp:preempt-rt = "linux-toradex-upstream-rt"
PREFERRED_VERSION_linux-toradex-upstream-rt = "6.6%"
PREFERRED_PROVIDER_virtual/dtb:use-mainline-bsp = "device-tree-overlays-mainline"

IMX_DEFAULT_BOOTLOADER:colibri-imx7-emmc = "u-boot-toradex"
PREFERRED_PROVIDER_u-boot-default-script = "u-boot-distro-boot"

MACHINE_FIRMWARE:remove = "firmware-imx-epdc"
MACHINE_FIRMWARE:remove:use-mainline-bsp = "firmware-imx-vpu-imx6q firmware-imx-vpu-imx6d"

UBOOT_BINARY:colibri-imx7-emmc = "u-boot.imx"
UBOOT_DTB_LOADADDRESS:colibri-imx7-emmc = "0x88200000"
UBOOT_DTBO_LOADADDRESS:colibri-imx7-emmc = "0x88300000"
UBOOT_ENTRYPOINT:colibri-imx7-emmc = "0x84200000"
UBOOT_MAKE_TARGET:colibri-imx7-emmc = "u-boot.imx"
UBOOT_RD_LOADADDRESS:colibri-imx7-emmc = "0x8A400000"
UBOOT_SUFFIX:${MACHINE} = "imx"
```

## layers/meta-toradex-nxp/conf/machine/include/colibri-imx7.inc
```bitbake
IMAGE_CLASSES:append = " image_type_tezi"
IMAGE_FSTYPES:append = " teziimg"
TORADEX_PRODUCT_IDS = "0032 0033 0041 0081"
TORADEX_PRODUCT_IDS[0032] = "imx7s-colibri-eval-v3.dtb"
TORADEX_PRODUCT_IDS[0033] = "imx7d-colibri-eval-v3.dtb"
TORADEX_PRODUCT_IDS[0041] = "imx7d-colibri-eval-v3.dtb"
TORADEX_PRODUCT_IDS[0081] = "imx7d-colibri-eval-v3.dtb"
TORADEX_FLASH_TYPE = "rawnand"

MACHINE_NAME = "Colibri-iMX7"

# with kernel 6.5 the device trees were moved to vendor subdirs
KERNEL_DTB_PREFIX = "nxp/imx/"
KERNEL_DTB_PREFIX:preempt-rt = "nxp/imx/"
KERNEL_DTB_PREFIX:use-nxp-bsp = ""
KERNEL_DEVICETREE:colibri-imx7 = " \
    ${KERNEL_DTB_PREFIX}imx7d-colibri-aster.dtb \
    ${KERNEL_DTB_PREFIX}imx7d-colibri-eval-v3.dtb \
    ${KERNEL_DTB_PREFIX}imx7d-colibri-iris.dtb \
    ${KERNEL_DTB_PREFIX}imx7d-colibri-iris-v2.dtb \
    ${KERNEL_DTB_PREFIX}imx7s-colibri-aster.dtb \
    ${KERNEL_DTB_PREFIX}imx7s-colibri-eval-v3.dtb \
    ${KERNEL_DTB_PREFIX}imx7s-colibri-iris.dtb \
    ${KERNEL_DTB_PREFIX}imx7s-colibri-iris-v2.dtb \
"

PREFERRED_PROVIDER_virtual/kernel = "linux-toradex"
PREFERRED_PROVIDER_virtual/kernel:preempt-rt = "linux-toradex"
PREFERRED_PROVIDER_virtual/kernel:use-mainline-bsp = "linux-toradex-upstream"
PREFERRED_VERSION_linux-toradex-upstream = "6.6%"
PREFERRED_PROVIDER_virtual/kernel:use-mainline-bsp:preempt-rt = "linux-toradex-upstream-rt"
PREFERRED_VERSION_linux-toradex-upstream-rt = "6.6%"
PREFERRED_PROVIDER_virtual/dtb:use-mainline-bsp = "device-tree-overlays-mainline"

IMX_DEFAULT_BOOTLOADER:colibri-imx7 = "u-boot-toradex"
PREFERRED_PROVIDER_u-boot-default-script = "u-boot-distro-boot"

MACHINE_FIRMWARE:remove = "firmware-imx-epdc"
MACHINE_FIRMWARE:remove:use-mainline-bsp = "firmware-imx-vpu-imx6q firmware-imx-vpu-imx6d"

UBOOT_DTB_LOADADDRESS:colibri-imx7 = "0x88200000"
UBOOT_DTBO_LOADADDRESS:colibri-imx7 = "0x88300000"
UBOOT_ENTRYPOINT:colibri-imx7 = "0x84200000"
UBOOT_MAKE_TARGET:colibri-imx7 = "u-boot-nand.imx"
UBOOT_RD_LOADADDRESS:colibri-imx7 = "0x88400000"
```

## layers/meta-toradex-nxp/conf/machine/toradex-smarc-imx8mp.conf
```bitbake
#@TYPE: Machine
#@NAME: Toradex SMARC iMX8M Plus
#@SOC: i.MX8MP
#@DESCRIPTION: Machine configuration for Toradex SMARC iMX8M Plus SoM
#@MAINTAINER: Max Krummenacher <max.krummenacher@toradex.com>

MACHINE_NAME = "SMARC-iMX8MP"

MACHINEOVERRIDES =. "tdx:mx8:mx8m:mx8mp:"

MACHINE_EXTRA_RRECOMMENDS:append = " mwifiexconf"

IMX_DEFAULT_BSP = "nxp"
IMX_DEFAULT_BSP:upstream = "mainline"

require conf/machine/include/imx-base.inc
# override imx-base.inc which sets this to cortexa53-crypto
DEFAULTTUNE:mx8mp-generic-bsp = "armv8a-crypto"
require conf/machine/include/arm/armv8a/tune-cortexa53.inc

# Don't include kernels in standard images
RRECOMMENDS:${KERNEL_PACKAGE_NAME}-base = ""

KERNEL_DTB_PREFIX = "freescale/"
KERNEL_DEVICETREE = " \
    ${KERNEL_DTB_PREFIX}imx8mp-toradex-smarc-dev.dtb \
"

KERNEL_IMAGETYPE:mx8-generic-bsp = "Image.gz"

UBOOT_CONFIG ??= "sd"
UBOOT_CONFIG[sd] = "toradex-smarc-imx8mp_defconfig,sdcard"
SPL_BINARY = "spl/u-boot-spl.bin"

UBOOT_DTB_LOADADDRESS:mx8mp-generic-bsp = "0x50200000"
UBOOT_DTBO_LOADADDRESS:mx8mp-generic-bsp = "0x50240000"
UBOOT_ENTRYPOINT:mx8mp-generic-bsp = "0x48200000"
UBOOT_RD_LOADADDRESS = "0x52300000"

# Set u-boot DTB
UBOOT_DTB_NAME = "imx8mp-toradex-smarc-dev.dtb"

# Set DDR FIRMWARE
LPDDR_FW_VERSION = "_202006"
DDR_FIRMWARE_NAME = " \
    lpddr4_pmu_train_1d_dmem${LPDDR_FW_VERSION}.bin \
    lpddr4_pmu_train_1d_imem${LPDDR_FW_VERSION}.bin \
    lpddr4_pmu_train_2d_dmem${LPDDR_FW_VERSION}.bin \
    lpddr4_pmu_train_2d_imem${LPDDR_FW_VERSION}.bin \
"

ATF_PLATFORM = "imx8mp"
SOC_ATF_BOOT_UART_BASE:toradex-smarc-imx8mp = "0x30a60000"

BOOT_SPACE = "65536"

# Set imx-mkimage boot target
IMXBOOT_TARGETS = "flash_evk_emmc_fastboot"
IMX_BOOT_SOC_TARGET = "iMX8MP"

IMAGE_BOOT_FILES:append = " boot.scr-${MACHINE};boot.scr"
WKS_FILE_DEPENDS:append = " u-boot-default-script"
PREFERRED_PROVIDER_u-boot-default-script = "u-boot-distro-boot"

LOADADDR = ""
UBOOT_SUFFIX = "bin"
UBOOT_MAKE_TARGET = ""
IMX_BOOT_SEEK = "32"

SERIAL_CONSOLES = "115200;ttymxc1"

MACHINE_FEATURES += "3g bluetooth alsa ext2 pci screen touchscreen tpm2 usbgadget usbhost vfat wifi"

PREFERRED_PROVIDER_virtual/kernel = "linux-toradex"
PREFERRED_PROVIDER_virtual/kernel:preempt-rt = "linux-toradex"
PREFERRED_PROVIDER_virtual/kernel:use-mainline-bsp = "linux-toradex-upstream"
PREFERRED_PROVIDER_virtual/kernel:use-mainline-bsp:preempt-rt = "linux-toradex-upstream"
PREFERRED_VERSION_linux-toradex-upstream = "6.12%"
PREFERRED_PROVIDER_virtual/dtb:use-mainline-bsp = "device-tree-overlays-mainline"
PREFERRED_VERSION_linux-imx-headers = "6.6"

IMX_DEFAULT_BOOTLOADER = "u-boot-toradex"
# variables to control imx-boot with u-boot
ATF_LOAD_ADDR = "0x920000"
IMX_EXTRA_FIRMWARE = "firmware-imx-8m"
TEE_LOAD_ADDR = "0xbe000000"
UBOOT_MAKE_TARGET:use-mainline-bsp = "all"

# handle machine firmware
MACHINE_FIRMWARE:append = " linux-firmware-nxp8997-sdio"
MACHINE_FIRMWARE:remove = "firmware-sof-imx"

IMAGE_CLASSES:append = " image_type_tezi"
IMAGE_FSTYPES += "teziimg"

UBOOT_BINARY_TEZI_EMMC = "imx-boot"
OFFSET_BOOTROM_PAYLOAD = "0"

TEZI_EXTERNAL_KERNEL_DEVICETREE_BOOT = " \
    toradex-smarc-imx8mp_spi0-cs0_spidev_overlay.dtbo \
    toradex-smarc-imx8mp_spi0-cs1_spidev_overlay.dtbo \
    toradex-smarc-imx8mp_spi1-cs0_spidev_overlay.dtbo \
    toradex-smarc-imx8mp_spi1-cs1_spidev_overlay.dtbo \
"

TORADEX_PRODUCT_IDS = "0097 0206 0207 0208 0209 0210"
```
