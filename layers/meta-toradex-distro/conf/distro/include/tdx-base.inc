## layers/meta-toradex-nxp/conf/machine/toradex-smarc-imx95.conf
```bitbake
#@TYPE: Machine
#@NAME: Toradex SMARC iMX95
#@SOC: i.MX 95
#@DESCRIPTION: Machine configuration for Toradex Toradex SMARC i.MX95
#@MAINTAINER: Max Krummenacher <max.krummenacher@toradex.com>

MACHINE_NAME = "SMARC-iMX95"

MACHINEOVERRIDES =. "tdx:mx95:"

# The IW611 chip is supported by the out-of-tree NXP WLAN driver and requires a
# workaround specified by btnxpuartconf to work together with btnxpuart
MACHINE_EXTRA_RRECOMMENDS:append = " kernel-module-nxp-wlan btnxpuartconf"
MACHINE_FIRMWARE:append = " linux-firmware-nxpiw612-sdio"

require conf/machine/include/imx-base.inc
require conf/machine/include/arm/armv8-2a/tune-cortexa55.inc

MACHINE_FEATURES += "pci wifi bluetooth optee tpm2"

IMX_DEFAULT_BSP = "nxp"

PREFERRED_PROVIDER_virtual/kernel = "linux-toradex"
KERNEL_IMAGETYPE:mx95-generic-bsp = "Image.gz"

KERNEL_DTB_PREFIX = "freescale/"
KERNEL_DEVICETREE:append:use-nxp-bsp = " \
    ${KERNEL_DTB_PREFIX}imx95-19x19-verdin-lt8912.dtb \
    ${KERNEL_DTB_PREFIX}imx95-toradex-smarc-dev.dtb \
"

IMX_DEFAULT_BOOTLOADER = "u-boot-toradex"
PREFERRED_VERSION_u-boot-toradex = "2024.04%"
UBOOT_SUFFIX = "bin"
SPL_BINARY = "spl/u-boot-spl.bin"
UBOOT_MAKE_TARGET = ""
UBOOT_CONFIG_BASENAME = "toradex-smarc-imx95"

UBOOT_CONFIG ??= "sd"
UBOOT_CONFIG[sd] = "${UBOOT_CONFIG_BASENAME}_defconfig"

UBOOT_DTB_LOADADDRESS:mx95-generic-bsp = "0x9c400000"
UBOOT_DTBO_LOADADDRESS:mx95-generic-bsp = "0x9c440000"
UBOOT_ENTRYPOINT:mx95-generic-bsp = "0x94400000"
UBOOT_RD_LOADADDRESS = "0x9c800000"

IMXBOOT_TARGETS = "flash_a55"
IMX_BOOT_SOC_TARGET = "iMX95"
IMX_BOOT_SEEK = "32"

IMAGE_BOOT_FILES:append = " boot.scr-${MACHINE};boot.scr"
WKS_FILE_DEPENDS:append = " u-boot-default-script"
PREFERRED_PROVIDER_u-boot-default-script = "u-boot-distro-boot"

ATF_PLATFORM = "imx95"

PREFERRED_PROVIDER_virtual/imx-oei = "imx-oei-toradex"
OEI_CONFIGS = "ddr tcm"
OEI_CORE   = "m33"
OEI_SOC    = "mx95"
OEI_BOARD  ?= "toradex-smarc-imx95"
DDR_TYPE   ?= "lpddr5"

DDR_FIRMWARE_NAME = " \
    lpddr5_dmem_v202311.bin \
    lpddr5_dmem_qb_v202311.bin \
    lpddr5_imem_v202311.bin \
    lpddr5_imem_qb_v202311.bin \
"

IMXBOOT_VARIANT = ""

PREFERRED_PROVIDER_virtual/imx-system-manager = "imx-sm-toradex"
SYSTEM_MANAGER_CONFIG = "tdx-smarc-imx95"
# The System Manager Firmware Name corresponds to a particular binary implementation
# in the Yocto deploy folder. The name is comprised of the Firmware Basename and the
# default system manager Config name, e.g., m33_image-mx95evk.bin and
# m33_image-mx95evk_fusa.bin for the standard BSP version and FuSa version, respectively
# The System Manager Firmware Basename is an alias used by imx-boot instead of using
# a unique name for each implementation, e.g., m33_image.bin for i.MX 95
SYSTEM_MANAGER_FIRMWARE_BASENAME ?= "m33_image"
SYSTEM_MANAGER_FIRMWARE_NAME ?= "m33_image-tdx-smarc-imx95"

# We have to disable SERIAL_CONSOLE due to auto-serial-console
SERIAL_CONSOLES = "115200;ttyLP1"

IMAGE_CLASSES:append = " image_type_tezi"
IMAGE_FSTYPES += "teziimg"

# The imx-boot container takes care for the i.MX 8 offset, so the container
# has to be flashed at offset 0 directly
UBOOT_BINARY_TEZI_EMMC = "imx-boot"
OFFSET_BOOTROM_PAYLOAD = "0"

TEZI_EXTERNAL_KERNEL_DEVICETREE_BOOT = " \
    toradex-smarc-imx95_spi0-cs0_spidev_overlay.dtbo \
    toradex-smarc-imx95_spi0-cs1_spidev_overlay.dtbo \
    toradex-smarc-imx95_spi1-cs0_spidev_overlay.dtbo \
    toradex-smarc-imx95_spi1-cs1_spidev_overlay.dtbo \
"

TORADEX_PRODUCT_IDS = "0096 0201 0202 0203 0204 0205"
```

## layers/meta-toradex-nxp/conf/machine/verdin-imx8mm.conf
```bitbake
#@TYPE: Machine
#@NAME: Toradex Verdin iMX8M Mini
#@SOC: i.MX8MM
#@DESCRIPTION: Machine configuration for Toradex Verdin iMX8M Mini SoM
#@MAINTAINER: Max Krummenacher <max.krummenacher@toradex.com>

MACHINE_NAME = "Verdin-iMX8MM"

MACHINEOVERRIDES =. "tdx:mx8:mx8m:mx8mm:"

MACHINE_EXTRA_RRECOMMENDS:append = " mwifiexconf"

IMX_DEFAULT_BSP = "nxp"
IMX_DEFAULT_BSP:upstream = "mainline"

require conf/machine/include/imx-base.inc
# override imx-base.inc which sets this to cortexa53-crypto
DEFAULTTUNE:mx8mm-generic-bsp = "armv8a-crypto"
require conf/machine/include/arm/armv8a/tune-cortexa53.inc

# Don't include kernels in standard images
RRECOMMENDS:${KERNEL_PACKAGE_NAME}-base = ""

KERNEL_DTB_PREFIX = "freescale/"
KERNEL_DEVICETREE = " \
    ${KERNEL_DTB_PREFIX}imx8mm-verdin-nonwifi-dahlia.dtb \
    ${KERNEL_DTB_PREFIX}imx8mm-verdin-nonwifi-dev.dtb \
    ${KERNEL_DTB_PREFIX}imx8mm-verdin-nonwifi-ivy.dtb \
    ${KERNEL_DTB_PREFIX}imx8mm-verdin-nonwifi-mallow.dtb \
    ${KERNEL_DTB_PREFIX}imx8mm-verdin-nonwifi-yavia.dtb \
    ${KERNEL_DTB_PREFIX}imx8mm-verdin-wifi-dahlia.dtb \
    ${KERNEL_DTB_PREFIX}imx8mm-verdin-wifi-dev.dtb \
    ${KERNEL_DTB_PREFIX}imx8mm-verdin-wifi-ivy.dtb \
    ${KERNEL_DTB_PREFIX}imx8mm-verdin-wifi-mallow.dtb \
    ${KERNEL_DTB_PREFIX}imx8mm-verdin-wifi-yavia.dtb \
"
KERNEL_IMAGETYPE:mx8-generic-bsp = "Image.gz"

UBOOT_CONFIG ??= "sd"
UBOOT_CONFIG[sd] = "verdin-imx8mm_defconfig,sdcard"
SPL_BINARY = "spl/u-boot-spl.bin"

UBOOT_DTB_LOADADDRESS:mx8mm-generic-bsp = "0x50200000"
UBOOT_DTBO_LOADADDRESS:mx8mm-generic-bsp = "0x50240000"
UBOOT_ENTRYPOINT:mx8mm-generic-bsp  = "0x48200000"
UBOOT_RD_LOADADDRESS = "0x52300000"

# Set u-boot DTB
UBOOT_DTB_NAME = "imx8mm-verdin-wifi-dev.dtb"

# Set DDR FIRMWARE
DDR_FIRMWARE_NAME = " \
    lpddr4_pmu_train_1d_imem.bin \
    lpddr4_pmu_train_1d_dmem.bin \
    lpddr4_pmu_train_2d_imem.bin \
    lpddr4_pmu_train_2d_dmem.bin \
"

ATF_PLATFORM = "imx8mm"
SOC_ATF_BOOT_UART_BASE:verdin-imx8mm = "0x30860000"

BOOT_SPACE = "65536"

# Set imx-mkimage boot target
IMXBOOT_TARGETS = "flash_evk_emmc_fastboot"
IMX_BOOT_SOC_TARGET = "iMX8MM"

IMAGE_BOOT_FILES:append = " boot.scr-${MACHINE};boot.scr"
WKS_FILE_DEPENDS:append = " u-boot-default-script"
PREFERRED_PROVIDER_u-boot-default-script = "u-boot-distro-boot"

LOADADDR = ""
UBOOT_SUFFIX = "bin"
UBOOT_MAKE_TARGET = ""
IMX_BOOT_SEEK = "33"

SERIAL_CONSOLES = "115200;ttymxc0"

MACHINE_FEATURES += "3g bluetooth alsa ext2 pci screen touchscreen tpm2 usbgadget usbhost vfat wifi"

PREFERRED_PROVIDER_virtual/kernel = "linux-toradex"
PREFERRED_PROVIDER_virtual/kernel:preempt-rt = "linux-toradex"
PREFERRED_PROVIDER_virtual/kernel:use-mainline-bsp = "linux-toradex-upstream"
PREFERRED_VERSION_linux-toradex-upstream = "6.6%"
PREFERRED_PROVIDER_virtual/kernel:use-mainline-bsp:preempt-rt = "linux-toradex-upstream-rt"
PREFERRED_VERSION_linux-toradex-upstream-rt = "6.6%"
PREFERRED_PROVIDER_virtual/dtb:use-mainline-bsp = "device-tree-overlays-mainline"
PREFERRED_VERSION_linux-imx-headers = "6.6"

IMX_DEFAULT_BOOTLOADER = "u-boot-toradex"
# variables to control imx-boot with u-boot
ATF_LOAD_ADDR = "0x920000"
IMX_EXTRA_FIRMWARE = "firmware-imx-8m"
TEE_LOAD_ADDR = "0xbe000000"
UBOOT_MAKE_TARGET:use-mainline-bsp = "all"

# handle machine firmware
MACHINE_FIRMWARE:append = " linux-firmware-ath10k linux-firmware-imx-sdma-imx7d"
MACHINE_FIRMWARE:append = " linux-firmware-sd8997"
MACHINE_FIRMWARE:append = " firmware-imx-vpu-imx8"

BOARD_TYPE = "verdin"

IMAGE_CLASSES:append = " image_type_tezi"
IMAGE_FSTYPES += "teziimg"

UBOOT_BINARY_TEZI_EMMC = "imx-boot"
OFFSET_BOOTROM_PAYLOAD = "2"

TEZI_EXTERNAL_KERNEL_DEVICETREE_BOOT = "verdin-imx8mm_dsi-to-hdmi_overlay.dtbo verdin-imx8mm_spidev_overlay.dtbo"

TORADEX_PRODUCT_IDS = "0055 0057 0059 0060 0068 0086 0087 0090"
TORADEX_PRODUCT_IDS[0055] = "imx8mm-verdin-wifi-v1.1-dev.dtb"
TORADEX_PRODUCT_IDS[0057] = "imx8mm-verdin-nonwifi-v1.1-dev.dtb"
TORADEX_PRODUCT_IDS[0059] = "imx8mm-verdin-nonwifi-v1.1-dev.dtb"
TORADEX_PRODUCT_IDS[0060] = "imx8mm-verdin-wifi-v1.1-dev.dtb"
TORADEX_PRODUCT_IDS[0068] = "imx8mm-verdin-wifi-v1.1-dev.dtb"
TORADEX_PRODUCT_IDS[0086] = "imx8mm-verdin-nonwifi-v1.1-dev.dtb"
TORADEX_PRODUCT_IDS[0087] = "imx8mm-verdin-nonwifi-v1.1-dev.dtb"
TORADEX_PRODUCT_IDS[0090] = "imx8mm-verdin-wifi-v1.1-dev.dtb"
```

## layers/meta-toradex-nxp/conf/machine/verdin-imx95.conf
```bitbake
#@TYPE: Machine
#@NAME: Toradex Verdin iMX95
#@SOC: i.MX 95
#@DESCRIPTION: Machine configuration for Toradex Verdin i.MX95
#@MAINTAINER: Max Krummenacher <max.krummenacher@toradex.com>

MACHINE_NAME = "Verdin-iMX95"

MACHINEOVERRIDES =. "tdx:mx95:"

# The IW611 chip is supported by the out-of-tree NXP WLAN driver and requires a
# workaround specified by btnxpuartconf to work together with btnxpuart
MACHINE_EXTRA_RRECOMMENDS:append = " kernel-module-nxp-wlan btnxpuartconf"
MACHINE_FIRMWARE:append = " linux-firmware-nxpiw612-sdio"

require conf/machine/include/imx-base.inc
require conf/machine/include/arm/armv8-2a/tune-cortexa55.inc

MACHINE_FEATURES += "pci wifi bluetooth optee tpm2"

IMX_DEFAULT_BSP = "nxp"

PREFERRED_PROVIDER_virtual/kernel = "linux-toradex"
KERNEL_IMAGETYPE:mx95-generic-bsp = "Image.gz"

KERNEL_DTB_PREFIX = "freescale/"
KERNEL_DEVICETREE:append:use-nxp-bsp = " \
    ${KERNEL_DTB_PREFIX}imx95-verdin-wifi-dahlia.dtb \
    ${KERNEL_DTB_PREFIX}imx95-verdin-wifi-dev.dtb \
    ${KERNEL_DTB_PREFIX}imx95-verdin-wifi-ivy.dtb \
    ${KERNEL_DTB_PREFIX}imx95-verdin-wifi-mallow.dtb \
    ${KERNEL_DTB_PREFIX}imx95-verdin-wifi-yavia.dtb \
    ${KERNEL_DTB_PREFIX}imx95-verdin-nonwifi-dahlia.dtb \
    ${KERNEL_DTB_PREFIX}imx95-verdin-nonwifi-dev.dtb \
    ${KERNEL_DTB_PREFIX}imx95-verdin-nonwifi-ivy.dtb \
    ${KERNEL_DTB_PREFIX}imx95-verdin-nonwifi-mallow.dtb \
    ${KERNEL_DTB_PREFIX}imx95-verdin-nonwifi-yavia.dtb \
"

IMX_DEFAULT_BOOTLOADER = "u-boot-toradex"
PREFERRED_VERSION_u-boot-toradex = "2024.04%"
UBOOT_SUFFIX = "bin"
SPL_BINARY = "spl/u-boot-spl.bin"
UBOOT_MAKE_TARGET = ""
UBOOT_CONFIG_BASENAME = "verdin-imx95"

UBOOT_CONFIG ??= "sd"
UBOOT_CONFIG[sd] = "${UBOOT_CONFIG_BASENAME}_defconfig"

UBOOT_DTB_LOADADDRESS:mx95-generic-bsp = "0x9c400000"
UBOOT_DTBO_LOADADDRESS:mx95-generic-bsp = "0x9c440000"
UBOOT_ENTRYPOINT:mx95-generic-bsp = "0x94400000"
UBOOT_RD_LOADADDRESS = "0x9c800000"

IMXBOOT_TARGETS = "flash_a55"
IMX_BOOT_SOC_TARGET = "iMX95"
IMX_BOOT_SEEK = "32"

IMAGE_BOOT_FILES:append = " boot.scr-${MACHINE};boot.scr"
WKS_FILE_DEPENDS:append = " u-boot-default-script"
PREFERRED_PROVIDER_u-boot-default-script = "u-boot-distro-boot"

ATF_PLATFORM = "imx95"

PREFERRED_PROVIDER_virtual/imx-oei = "imx-oei-toradex"
OEI_CONFIGS = "ddr tcm"
OEI_CORE   = "m33"
OEI_SOC    = "mx95"
OEI_BOARD  ?= "toradex-verdin-imx95"
DDR_TYPE   ?= "lpddr4x"

LPDDR_FW_VERSION = "_v202409"
DDR_FIRMWARE_NAME = " \
    lpddr4x_dmem${LPDDR_FW_VERSION}.bin \
    lpddr4x_dmem_qb${LPDDR_FW_VERSION}.bin \
    lpddr4x_imem${LPDDR_FW_VERSION}.bin \
    lpddr4x_imem_qb${LPDDR_FW_VERSION}.bin \
"

IMXBOOT_VARIANT = ""

PREFERRED_PROVIDER_virtual/imx-system-manager = "imx-sm-toradex"
SYSTEM_MANAGER_CONFIG = "tdx-verdin-imx95"
# The System Manager Firmware Name corresponds to a particular binary implementation
# in the Yocto deploy folder. The name is comprised of the Firmware Basename and the
# default system manager Config name, e.g., m33_image-mx95evk.bin and
# m33_image-mx95evk_fusa.bin for the standard BSP version and FuSa version, respectively
# The System Manager Firmware Basename is an alias used by imx-boot instead of using
# a unique name for each implementation, e.g., m33_image.bin for i.MX 95
SYSTEM_MANAGER_FIRMWARE_BASENAME ?= "m33_image"
SYSTEM_MANAGER_FIRMWARE_NAME ?= "m33_image-tdx-verdin-imx95"

# We have to disable SERIAL_CONSOLE due to auto-serial-console
SERIAL_CONSOLES = "115200;ttyLP2"

IMAGE_CLASSES:append = " image_type_tezi"
IMAGE_FSTYPES += "teziimg"

# The imx-boot container takes care of the i.MX 9 offset, so the container
# has to be flashed at offset 0 directly
UBOOT_BINARY_TEZI_EMMC = "imx-boot"
OFFSET_BOOTROM_PAYLOAD = "0"

TEZI_EXTERNAL_KERNEL_DEVICETREE_BOOT = "verdin-imx95_dsi-to-hdmi_overlay.dtbo verdin-imx95_spidev_overlay.dtbo"

TORADEX_PRODUCT_IDS = "0089"
```

## layers/meta-toradex-ti/conf/machine/aquila-am69-k3r5.conf
```bitbake
#@TYPE: Machine
#@NAME: Toradex Aquila AM69 (R5F)
#@DESCRIPTION: Machine configuration for Toradex Aquila AM69 SoM (R5F core)
#@MAINTAINER: Max Krummenacher <max.krummenacher@toradex.com>

MACHINE_NAME = "Aquila-AM69"

require conf/machine/include/k3r5.inc

PREFERRED_PROVIDER_virtual/bootloader = "u-boot-toradex-ti"
PREFERRED_PROVIDER_u-boot = "u-boot-toradex-ti"
PREFERRED_PROVIDER_virtual/bootloader:upstream = "u-boot-toradex"
PREFERRED_PROVIDER_u-boot:upstream = "u-boot-toradex"
PREFERRED_VERSION_u-boot-toradex:upstream = "mainline"

SYSFW_SOC = "am69"
SYSFW_CONFIG = "aquila"
SYSFW_SUFFIX = "hs-fs"

UBOOT_CONFIG ??= "sd-r5"
UBOOT_CONFIG[sd-r5] = "aquila-am69_r5_defconfig,sdcard,spl/u-boot-spl.bin"
```

## layers/meta-toradex-ti/conf/machine/aquila-am69.conf
```bitbake
#@TYPE: Machine
#@NAME: Toradex Aquila AM69
#@DESCRIPTION: Machine configuration for Toradex Aquila AM69 SoM
#@MAINTAINER: Max Krummenacher <max.krummenacher@toradex.com>

MACHINE_NAME = "Aquila-AM69"
MACHINE_FEATURES:remove = "efi"
MACHINE_FEATURES:append = " tpm2"

MACHINEOVERRIDES =. "tdx:"

require conf/machine/tdx-utilities.inc
require conf/machine/include/j784s4.inc

TFA_K3_USART = "0x8"
OPTEE_K3_USART = "0x8"

do_image[mcdepends] = "mc::k3r5:virtual/bootloader:do_deploy"

# cope with our changed tiboot3 file names vs. the hardcoded TI AM69 SK-EVM ones
IMAGE_BOOT_FILES:remove = "\
    tiboot3-j784s4-gp-evm.bin \
    tiboot3-j784s4-hs-evm.bin \
    tiboot3-j784s4-hs-fs-evm.bin \
"

# Don't include kernels and DTBs in standard images
RRECOMMENDS:${KERNEL_PACKAGE_NAME}-base = ""
MACHINE_ESSENTIAL_EXTRA_RDEPENDS:remove = "kernel-image-image kernel-devicetree"
# Install kernel modules by default
MACHINE_EXTRA_RRECOMMENDS:append = " kernel-modules"

TI_PREFERRED_BSP = "ti-6_6"
PREFERRED_PROVIDER_virtual/kernel = "linux-toradex-ti"
PREFERRED_PROVIDER_virtual/kernel:preempt-rt = "linux-toradex-ti"
PREFERRED_PROVIDER_virtual/dtb = "device-tree-overlays-ti"
PREFERRED_PROVIDER_virtual/bootloader = "u-boot-toradex-ti"
PREFERRED_PROVIDER_u-boot = "u-boot-toradex-ti"

KERNEL_DTB_PREFIX = "ti/"
KERNEL_DEVICETREE = " \
    ${KERNEL_DTB_PREFIX}k3-am69-aquila-clover.dtb \
    ${KERNEL_DTB_PREFIX}k3-am69-aquila-dev.dtb \
    ${KERNEL_DTB_PREFIX}k3-am69-aquila-v1.0-clover.dtb \
    ${KERNEL_DTB_PREFIX}k3-am69-aquila-v1.0-dev.dtb \
"

KERNEL_IMAGETYPE = "Image.gz"
KERNEL_IMAGETYPES = "fitImage Image Image.gz"

# overlays applied by generated overlays.txt
TEZI_EXTERNAL_KERNEL_DEVICETREE_BOOT = "aquila-am69_spi1_spidev_overlay.dtbo aquila-am69_spi2_spidev_overlay.dtbo"

UBOOT_CONFIG ??= "sd"
UBOOT_CONFIG[sd] = "aquila-am69_a72_defconfig,sdcard"
UBOOT_ENTRYPOINT = "0x80200000"
UBOOT_LOADADDRESS = "0x80200000"

IMAGE_BOOT_FILES = " \
    boot.scr-${MACHINE};boot.scr \
    ${KERNEL_IMAGETYPE} \
    ${@make_dtb_boot_files(d)} \
"

MACHINE_EXTRA_RRECOMMENDS:append = " linux-firmware-ath11k linux-firmware-ath12k linux-firmware-qca"

# meta-ti-bsp/conf/machine/include/k3.inc
# With "sdimage-2part-efi.wks" my builds do not boot, no serial output at
# all
WKS_FILE:k3 = "sdimage-2part.wks"
WKS_FILE_DEPENDS:append = " u-boot-distro-boot"
WIC_CREATE_EXTRA_ARGS:append = " --no-fstab-update"

IMAGE_CLASSES:append = " image_type_tezi"
IMAGE_FSTYPES:append = " teziimg"
# The payload offsets are given in number of 512 byte blocks.
# tiboot3.bin
OFFSET_BOOTROM_PAYLOAD = "0"
FIRMWARE_BINARY[0088] = "tiboot3-am69-hs-fs-aquila.bin"
FIRMWARE_BINARY[0211] = "tiboot3-am69-hs-fs-aquila.bin"
FIRMWARE_BINARY[0212] = "tiboot3-am69-hs-fs-aquila.bin"
FIRMWARE_BINARY[0213] = "tiboot3-am69-hs-fs-aquila.bin"
FIRMWARE_BINARY[0214] = "tiboot3-am69-hs-fs-aquila.bin"
FIRMWARE_BINARY[0215] = "tiboot3-am69-hs-fs-aquila.bin"
# tispl.bin
OFFSET_FW_PAYLOAD = "1024"
# u-boot.img
OFFSET_SPL_PAYLOAD = "5120"
UBOOT_BINARY = "u-boot.img"

TORADEX_PRODUCT_IDS = "0088 0211 0212 0213 0214 0215"
```
