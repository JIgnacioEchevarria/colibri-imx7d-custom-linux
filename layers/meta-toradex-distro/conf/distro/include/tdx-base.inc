## layers/meta-toradex-distro/conf/distro/include/tdx-base.inc
```bitbake
require conf/distro/poky.conf
require conf/distro/include/arm-defaults.inc

DISTRO = "tdx-base"
DISTRO_NAME = "Toradex Distro Base"

TDX_BUILDNBR ?= "0"
TDX_PURPOSE ?= "Testing"

def get_tdx_prerelease(purpose, datetime):
    if purpose == "Testing":
        return '-devel-%s' % (datetime)
    elif purpose == "Nightly":
        return '-devel-%s' % (datetime[:8])
    elif purpose == "Monthly":
        return '-devel-%s' % (datetime[:6])
    elif purpose == "Release":
        return ''
    else:
        return '-devel-%s' % (datetime)

TDX_BUILD ?= "+build.${TDX_BUILDNBR}"
TDX_MATRIX_BUILD_TIME ?= "${DATETIME}"
TDX_MATRIX_BUILD_TIME[vardepsexclude] = "DATETIME"
TDX_PRERELEASE ?= "${@get_tdx_prerelease(d.getVar('TDX_PURPOSE'), d.getVar('TDX_MATRIX_BUILD_TIME'))}"
TDX_MAJOR ?= "7"
TDX_MINOR ?= "3"
TDX_PATCH ?= "0"
TDX_RELEASE ?= "${TDX_MAJOR}.${TDX_MINOR}.${TDX_PATCH}"

# Toradex Version number without date for U-Boot/Kernel and other Toradex
# specific software artifacts.
TDX_VERSION ?= "${TDX_RELEASE}${@'' if d.getVar('TDX_PURPOSE') == 'Release' else '-devel'}"

# Show Tezi EULA license
TEZI_SHOW_EULA_LICENSE ?= "1"
TEZI_SHOW_EULA_LICENSE:use-mainline-bsp ?= "0"
TEZI_SHOW_EULA_LICENSE:colibri-imx6:use-mainline-bsp ?= "1"
TEZI_SHOW_EULA_LICENSE:apalis-imx6:use-mainline-bsp ?= "1"

# Complete image version with date and build number
DISTRO_VERSION = "${TDX_RELEASE}${TDX_PRERELEASE}${TDX_BUILD}"

SDK_VENDOR = "-tdxsdk"
SDK_NAME_PREFIX = "${DISTRO}"
# do not use elements in SDK_VERSION which are in vardepsexclude
SDK_VERSION = "${TDX_RELEASE}"

MAINTAINER = "Toradex <yocto-patches@toradex.com>"

TARGET_VENDOR = "-tdx"

DISTROOVERRIDES .= ":tdx-distro"

# create etc/build in the rootfs
INHERIT += "image-buildinfo"

# Log information on images and packages
INHERIT += "buildhistory"
BUILDHISTORY_COMMIT = "1"

IMAGE_LINGUAS ?= "en-us"

# Some Toradex recipes like linux-toradex, u-boot-toradex,
# device-tree-overlays are appending SCM hashes to PV, version
# numbers going backwards are not a problem as we don't provide
# binary feeds.
#
# This avoids some annoying errors as follows:
# | QA Issue: Package version went backwards which would break package feeds
ERROR_QA:remove = "version-going-backwards"

DISTRO_FEATURES:append = " pam systemd usrmerge tpm2"
DISTRO_FEATURES:remove = "sysvinit ptest"
VIRTUAL-RUNTIME_init_manager = "systemd"
PACKAGECONFIG:append:pn-systemd = " serial-getty-generator"
PACKAGECONFIG:append:pn-qemu-native = " libusb"

PREFERRED_PROVIDER_u-boot-fw-utils = "libubootenv"
PREFERRED_RPROVIDER_u-boot-fw-utils = "libubootenv"

PREFERRED_PROVIDER_virtual/dtb ?= "device-tree-overlays"

PREFERRED_PROVIDER_opencl-headers:imxgpu      = "imx-gpu-viv"
PREFERRED_PROVIDER_opencl-clhpp:imxgpu        = "imx-gpu-viv"
PREFERRED_PROVIDER_opencl-icd-loader:imxgpu   = "imx-gpu-viv"
PREFERRED_RPROVIDER_opencl-icd-loader:imxgpu  = "libopencl-imx"

# keep the dtb vendor directories in fitimage node names
KERNEL_DTBVENDORED = "1"

# Defines the root home directory as /root, as required by systemd.
ROOT_HOME = "/root"
```

## layers/meta-toradex-distro/conf/distro/tdx-xwayland-upstream-rt.conf
```bitbake
# Toradex Distro for Wayland with XWayland.
# Using the upstream kernel flavour with rt-patch applied.

require conf/distro/tdx-xwayland-upstream.conf

DISTRO = "tdx-xwayland-upstream-rt"
DISTRO_NAME = "TDX Wayland with XWayland Upstream RT"
DISTROOVERRIDES .= ":preempt-rt"
DISTRO_FLAVOUR = " (UPSTREAM PREEMPT_RT)"

IMAGE_BASENAME:append = "-rt"
```

## layers/meta-toradex-distro/conf/distro/tdx-xwayland-upstream.conf
```bitbake
# Toradex Distro for Wayland with XWayland.
# Using the upstream kernel flavour.

require conf/distro/tdx-xwayland.conf

DISTRO = "tdx-xwayland-upstream"
DISTRO_NAME = "TDX Wayland with XWayland Upstream"
DISTROOVERRIDES .= ":upstream"
DISTRO_FLAVOUR = " (UPSTREAM)"

IMX_DEFAULT_BSP = "mainline"

IMAGE_BASENAME:append = "-upstream"
```

## layers/meta-toradex-nxp/conf/layer.conf
```bitbake
# We have a conf and classes directory, append to BBPATH
BBPATH .= ":${LAYERDIR}"

# We have recipes-* directories, add to BBFILES
BBFILES += "${LAYERDIR}/recipes-*/*/*.bb ${LAYERDIR}/recipes-*/*/*.bbappend"
# Recipes which backport later versions of other layers are placed here.
# Only valid for Toradex distributions.
BACKPORT_BBFILES = "${LAYERDIR}/backports/recipes-*/*/*.bb ${LAYERDIR}/backports/recipes-*/*/*.bbappend"
BBFILES += "${@ d.getVar('BACKPORT_BBFILES') if 'tdx' in d.getVar('DISTROOVERRIDES').split(':') else ''}"

BBFILE_COLLECTIONS += "toradex-nxp-layer"
BBFILE_PATTERN_toradex-nxp-layer = "^${LAYERDIR}/"
BBFILE_PRIORITY_toradex-nxp-layer = "22"

# Let us add layer-specific bbappends which are only applied when that
# layer is included in our configuration
BBFILES += "${@' '.join('${LAYERDIR}/%s/recipes*/*/*.bbappend' % layer \
               for layer in BBFILE_COLLECTIONS.split())}"
# Add layer-specific bb files too
BBFILES += "${@' '.join('${LAYERDIR}/%s/recipes*/*/*.bb' % layer \
               for layer in BBFILE_COLLECTIONS.split())}"

LAYERDEPENDS_toradex-nxp-layer = " \
    core \
    freescale-layer \
    freescale-3rdparty \
    toradex-bsp-common-layer \
"
LAYERSERIES_COMPAT_toradex-nxp-layer = "nanbield scarthgap"
```

## layers/meta-toradex-nxp/conf/machine/apalis-imx8.conf
```bitbake
#@TYPE: Machine
#@NAME: Toradex Apalis iMX8
#@DESCRIPTION: Toradex Apalis iMX8 powered by a i.MX 8QuadMax SoC
#@MAINTAINER: Stefan Agner <stefan.agner@toradex.com>

MACHINE_NAME = "Apalis-iMX8"

SOC_SILICON_REV ?= ""

MACHINEOVERRIDES =. "tdx:mx8:mx8qm:"

MACHINE_EXTRA_RRECOMMENDS:append = " mwifiexconf"

IMX_DEFAULT_BSP = "nxp"

require conf/machine/include/imx-base.inc
# override imx-base.inc which sets this to cortexa72-cortexa53-crypto
DEFAULTTUNE:mx8qm-generic-bsp = "armv8a-crypto"
require conf/machine/include/arm/armv8a/tune-cortexa72-cortexa53.inc

# Don't include kernels in standard images
RRECOMMENDS:${KERNEL_PACKAGE_NAME}-base = ""

LOADADDR = ""

# we do not want to have getty running on tty1 as we run
# auto-serial-console there
USE_VT = "0"

KERNEL_DTB_PREFIX = "freescale/"
KERNEL_DEVICETREE = " \
    ${KERNEL_DTB_PREFIX}imx8qm-apalis-eval.dtb \
    ${KERNEL_DTB_PREFIX}imx8qm-apalis-eval-v1.2.dtb \
    ${KERNEL_DTB_PREFIX}imx8qm-apalis-ixora-v1.1.dtb \
    ${KERNEL_DTB_PREFIX}imx8qm-apalis-v1.1-eval.dtb \
    ${KERNEL_DTB_PREFIX}imx8qm-apalis-v1.1-eval-v1.2.dtb \
    ${KERNEL_DTB_PREFIX}imx8qm-apalis-v1.1-ixora-v1.1.dtb \
    ${KERNEL_DTB_PREFIX}imx8qm-apalis-v1.1-ixora-v1.2.dtb \
    ${KERNEL_DTB_PREFIX}imx8qp-apalis-v1.1-eval.dtb \
    ${KERNEL_DTB_PREFIX}imx8qp-apalis-v1.1-eval-v1.2.dtb \
    ${KERNEL_DTB_PREFIX}imx8qp-apalis-v1.1-ixora-v1.1.dtb	\
    ${KERNEL_DTB_PREFIX}imx8qp-apalis-v1.1-ixora-v1.2.dtb \
"

KERNEL_IMAGETYPE:mx8-generic-bsp = "Image.gz"

UBOOT_SUFFIX = "bin"
UBOOT_CONFIG ??= "sd"
UBOOT_CONFIG[sd] = "apalis-imx8_defconfig,sdcard"

UBOOT_ENTRYPOINT = "0x96000000"
UBOOT_DTB_LOADADDRESS = "0x83000000"
UBOOT_DTBO_LOADADDRESS = "0x83100000"
UBOOT_RD_LOADADDRESS = "0xA0000000"

ATF_PLATFORM = "imx8qm"

BOOT_SPACE = "65536"
IMX_BOOT_SEEK = "32"

IMAGE_BOOT_FILES:append = " boot.scr-${MACHINE};boot.scr hdmitxfw.bin dpfw.bin"
WKS_FILE_DEPENDS:append = " u-boot-default-script"
PREFERRED_PROVIDER_u-boot-default-script = "u-boot-distro-boot"

PREFERRED_PROVIDER_virtual/kernel = "linux-toradex"
PREFERRED_PROVIDER_virtual/kernel:preempt-rt = "linux-toradex"
PREFERRED_VERSION_linux-imx-headers = "6.6"
PREFERRED_PROVIDER_virtual/bootloader = "u-boot-toradex"
PREFERRED_PROVIDER_u-boot = "u-boot-toradex"
# Currently we use the nxp 2024.04 downstream for mx8
PREFERRED_VERSION_u-boot-toradex = "2024.04%"

MACHINE_FIRMWARE:append = " linux-firmware-pcie8997 firmware-imx-hdmi"

IMXBOOT_TARGETS = "flash_b0"
IMX_BOOT_SOC_TARGET = "iMX8QM"

PREFERRED_PROVIDER_imx-sc-firmware = "imx-sc-firmware-toradex"
BOARD_TYPE = "apalis"

IMAGE_CLASSES:append = " image_type_tezi"
IMAGE_FSTYPES += "teziimg"

# The imx-boot container takes care for the i.MX 8 offset, so the container
# has to be flashed at offset 0 directly
UBOOT_BINARY_TEZI_EMMC = "imx-boot"
OFFSET_BOOTROM_PAYLOAD = "0"

TEZI_EXTERNAL_KERNEL_DEVICETREE_BOOT = " \
    apalis-imx8_hdmi_overlay.dtbo \
    apalis-imx8_spi1_spidev_overlay.dtbo \
    apalis-imx8_spi2_spidev_overlay.dtbo \
"

TORADEX_PRODUCT_IDS = "0037 0047 0048 0049 0067 0091 0092 0093 0094 0095"
TORADEX_PRODUCT_IDS[0037] = "imx8qm-apalis-v1.1-eval.dtb"
TORADEX_PRODUCT_IDS[0047] = "imx8qm-apalis-v1.1-eval.dtb"
TORADEX_PRODUCT_IDS[0048] = "imx8qp-apalis-v1.1-eval.dtb"
TORADEX_PRODUCT_IDS[0049] = "imx8qp-apalis-v1.1-eval.dtb"
TORADEX_PRODUCT_IDS[0067] = "imx8qm-apalis-v1.1-eval.dtb"
TORADEX_PRODUCT_IDS[0091] = "imx8qm-apalis-v1.1-eval.dtb"
TORADEX_PRODUCT_IDS[0092] = "imx8qm-apalis-v1.1-eval.dtb"
TORADEX_PRODUCT_IDS[0093] = "imx8qp-apalis-v1.1-eval.dtb"
TORADEX_PRODUCT_IDS[0094] = "imx8qp-apalis-v1.1-eval.dtb"
TORADEX_PRODUCT_IDS[0095] = "imx8qm-apalis-v1.1-eval.dtb"
```

## layers/meta-toradex-nxp/conf/machine/colibri-imx6ull-emmc.conf
```bitbake
#@TYPE: Machine
#@NAME: Toradex Colibri iMX6ULL 1GB (eMMC)
#@SOC: i.MX6ULL
#@DESCRIPTION: Machine configuration for Toradex Colibri iMX6 ULL 1GB (eMMC) SOM
#@MAINTAINER: Max Krummenacher <max.krummenacher@toradex.com>

MACHINEOVERRIDES =. "tdx:mx6:mx6ul:mx6ull:"

require conf/machine/include/imx-base.inc
require conf/machine/include/arm/armv7a/tune-cortexa7.inc

PREFERRED_PROVIDER_virtual/kernel:use-nxp-bsp ?= "linux-toradex"
PREFERRED_PROVIDER_virtual/kernel:preempt-rt = "linux-toradex"

PREFERRED_PROVIDER_virtual/kernel:use-mainline-bsp = "linux-toradex-upstream"
PREFERRED_PROVIDER_virtual/kernel:use-mainline-bsp:preempt-rt = "linux-toradex-upstream-rt"
PREFERRED_PROVIDER_virtual/dtb:use-mainline-bsp = "device-tree-overlays-mainline"

# with kernel 6.5 the device trees were moved to vendor subdirs
KERNEL_DTB_PREFIX = "nxp/imx/"
KERNEL_DTB_PREFIX:preempt-rt = "nxp/imx/"
KERNEL_DTB_PREFIX:use-nxp-bsp = ""
KERNEL_DEVICETREE = " \
    ${KERNEL_DTB_PREFIX}imx6ull-colibri-emmc-aster.dtb \
    ${KERNEL_DTB_PREFIX}imx6ull-colibri-emmc-eval-v3.dtb \
    ${KERNEL_DTB_PREFIX}imx6ull-colibri-emmc-iris.dtb \
    ${KERNEL_DTB_PREFIX}imx6ull-colibri-emmc-iris-v2.dtb \
"

KERNEL_IMAGETYPE = "zImage"
# The kernel lives in its own ubi volume.
RRECOMMENDS:${KERNEL_PACKAGE_NAME}-base = ""

IMX_DEFAULT_BOOTLOADER = "u-boot-toradex"
PREFERRED_PROVIDER_u-boot-default-script ?= "u-boot-script-toradex"
UBOOT_MAKE_TARGET = "u-boot.imx"
UBOOT_MACHINE ?= "colibri-imx6ull-emmc_defconfig"
UBOOT_SUFFIX = "imx"

IMAGE_FSTYPES += "tar.xz"
# wic support
IMAGE_BOOT_FILES:append = " boot.scr-${MACHINE};boot.scr"
WKS_FILE_DEPENDS:append = " u-boot-default-script"
WKS_FILE = "sdimage-bootpart.wks"

MACHINE_FEATURES += "screen usbgadget usbhost vfat ext2 alsa touchscreen wifi bluetooth 3g"
MACHINE_FIRMWARE:remove = "firmware-imx-epdc"
```

## layers/meta-toradex-nxp/conf/machine/colibri-imx7.conf
```bitbake
# cope with renamed machine file in meta-freescale-3rdparty
MACHINEOVERRIDES =. "tdx:"
require conf/machine/colibri-imx7-nand.conf
```

## layers/meta-toradex-nxp/conf/machine/colibri-imx8x.conf
```bitbake
#@TYPE: Machine
#@NAME: Toradex Colibri iMX8X
#@DESCRIPTION: Toradex Colibri iMX8X powered by a i.MX 8X SoC
#@MAINTAINER: Max Krummenacher <max.krummenacherr@toradex.com>

MACHINE_NAME = "Colibri-iMX8X"

MACHINEOVERRIDES =. "tdx:mx8:mx8x:mx8qxp:"

MACHINE_EXTRA_RRECOMMENDS:append = " mwifiexconf"

IMX_DEFAULT_BSP = "nxp"

require conf/machine/include/imx-base.inc
# if one wants cortexa35-crypto, set DEFAULTTUNE accordingly
DEFAULTTUNE:mx8qxp-generic-bsp = "armv8a-crypto"
require conf/machine/include/arm/armv8a/tune-cortexa35.inc

# Don't include kernels in standard images
RRECOMMENDS:${KERNEL_PACKAGE_NAME}-base = ""

LOADADDR = ""

# we do not want to have getty running on tty1 as we run
# auto-serial-console there
USE_VT = "0"

KERNEL_DTB_PREFIX = "freescale/"
KERNEL_DEVICETREE = " \
    ${KERNEL_DTB_PREFIX}imx8dx-colibri-aster.dtb \
    ${KERNEL_DTB_PREFIX}imx8dx-colibri-eval-v3.dtb \
    ${KERNEL_DTB_PREFIX}imx8dx-colibri-iris.dtb \
    ${KERNEL_DTB_PREFIX}imx8dx-colibri-iris-v2.dtb \
    ${KERNEL_DTB_PREFIX}imx8qxp-colibri-aster.dtb \
    ${KERNEL_DTB_PREFIX}imx8qxp-colibri-eval-v3.dtb \
    ${KERNEL_DTB_PREFIX}imx8qxp-colibri-iris.dtb \
    ${KERNEL_DTB_PREFIX}imx8qxp-colibri-iris-v2.dtb \
"

KERNEL_IMAGETYPE:mx8-generic-bsp = "Image.gz"

UBOOT_SUFFIX = "bin"
UBOOT_CONFIG ??= "sd"
UBOOT_CONFIG[sd] = "colibri-imx8x_defconfig,sdcard"

UBOOT_ENTRYPOINT = "0x96000000"
UBOOT_DTB_LOADADDRESS = "0x83100000"
UBOOT_DTBO_LOADADDRESS = "0x83200000"
UBOOT_RD_LOADADDRESS = "0xA0000000"

ATF_PLATFORM = "imx8qx"

BOOT_SPACE = "65536"
IMX_BOOT_SEEK = "32"

IMAGE_BOOT_FILES:append = " boot.scr-${MACHINE};boot.scr"
WKS_FILE_DEPENDS:append = " u-boot-default-script"
PREFERRED_PROVIDER_u-boot-default-script = "u-boot-distro-boot"

PREFERRED_PROVIDER_virtual/kernel = "linux-toradex"
PREFERRED_PROVIDER_virtual/kernel:preempt-rt = "linux-toradex"
PREFERRED_PROVIDER_virtual/kernel:use-mainline-bsp = "linux-toradex-upstream"
PREFERRED_PROVIDER_virtual/kernel:use-mainline-bsp:preempt-rt = "linux-toradex-upstream-rt"
PREFERRED_PROVIDER_virtual/dtb:use-mainline-bsp = "device-tree-overlays-mainline"
PREFERRED_VERSION_linux-imx-headers = "6.6"

PREFERRED_PROVIDER_virtual/bootloader = "u-boot-toradex"
PREFERRED_PROVIDER_u-boot = "u-boot-toradex"
# Currently we use the nxp 2024.04 downstream for mx8
PREFERRED_VERSION_u-boot-toradex = "2024.04%"

MACHINE_FIRMWARE:append = " linux-firmware-pcie8997"

IMXBOOT_TARGETS = "flash"
IMX_BOOT_SOC_TARGET = "iMX8QX"

PREFERRED_PROVIDER_imx-sc-firmware = "imx-sc-firmware-toradex"
BOARD_TYPE = "colibri"

IMAGE_CLASSES:append = " image_type_tezi"
IMAGE_FSTYPES += "teziimg"

# The imx-boot container takes care for the i.MX 8 offset, so the container
# has to be flashed at offset 0 directly
UBOOT_BINARY_TEZI_EMMC = "imx-boot"
OFFSET_BOOTROM_PAYLOAD = "0"

TEZI_EXTERNAL_KERNEL_DEVICETREE_BOOT = "colibri-imx8x_vga-640x480_overlay.dtbo"

TORADEX_PRODUCT_IDS = "0038 0050 0051 0052"
TORADEX_PRODUCT_IDS[0038] = "imx8qxp-colibri-eval-v3.dtb"
TORADEX_PRODUCT_IDS[0050] = "imx8qxp-colibri-eval-v3.dtb"
TORADEX_PRODUCT_IDS[0051] = "imx8qxp-colibri-eval-v3.dtb"
TORADEX_PRODUCT_IDS[0052] = "imx8qxp-colibri-eval-v3.dtb"
```
