## layers/meta-toradex-ti/conf/machine/verdin-am62-k3r5.conf
```bitbake
#@TYPE: Machine
#@NAME: Toradex Verdin AM62 (R5F)
#@DESCRIPTION: Machine configuration for Toradex Verdin AM62 SoM (R5F core)
#@MAINTAINER: Max Krummenacher <max.krummenacher@toradex.com>

MACHINE_NAME = "Verdin-AM62"

require conf/machine/include/k3r5.inc

PREFERRED_PROVIDER_virtual/bootloader = "u-boot-toradex-ti"
PREFERRED_PROVIDER_u-boot = "u-boot-toradex-ti"

SYSFW_SOC = "am62x"
SYSFW_CONFIG = "verdin"
SYSFW_SUFFIX = "hs-fs"

UBOOT_CONFIG ??= "sd-r5"
UBOOT_CONFIG[sd-r5] = "verdin-am62_r5_defconfig,sdcard,spl/u-boot-spl.bin"
```

## layers/meta-toradex-ti/conf/machine/verdin-am62p-k3r5.conf
```bitbake
#@TYPE: Machine
#@NAME: Toradex Verdin AM62P (R5F)
#@DESCRIPTION: Machine configuration for Toradex Verdin AM62P SoM (R5F core)
#@MAINTAINER: Max Krummenacher <max.krummenacher@toradex.com>

MACHINE_NAME = "Verdin-AM62P"

require conf/machine/include/k3r5.inc

PREFERRED_PROVIDER_virtual/bootloader = "u-boot-toradex-ti"
PREFERRED_PROVIDER_u-boot = "u-boot-toradex-ti"

SYSFW_SOC = "am62px"
SYSFW_CONFIG = "verdin"
SYSFW_SUFFIX = "hs-fs"

UBOOT_CONFIG ??= "sd-r5"
UBOOT_CONFIG[sd-r5] = "verdin-am62p_r5_defconfig,sdcard,spl/u-boot-spl.bin"
```

## layers/meta-toradex-ti/conf/machine/verdin-am62p.conf
```bitbake
#@TYPE: Machine
#@NAME: Toradex Verdin AM62P
#@DESCRIPTION: Machine configuration for Toradex Verdin AM62P SoM
#@MAINTAINER: Max Krummenacher <max.krummenacher@toradex.com>

MACHINE_NAME = "Verdin-AM62P"
MACHINE_FEATURES:remove = "efi"
MACHINE_FEATURES:append = " tpm2"

MACHINEOVERRIDES =. "tdx:"

# The IW611 chip is supported by the out-of-tree NXP WLAN driver and requires a
# workaround specified by btnxpuartconf to work together with btnxpuart
MACHINE_EXTRA_RRECOMMENDS:append = " kernel-module-nxp-wlan btnxpuartconf"

require conf/machine/tdx-utilities.inc
require conf/machine/include/am62pxx.inc

do_image[mcdepends] = "mc::k3r5:virtual/bootloader:do_deploy"

# cope with our changed tiboot3 file names vs. the hardcoded TI SK-AM62P-LP ones
IMAGE_BOOT_FILES:remove = "tiboot3-am62px-hs-fs-evm.bin"
IMAGE_BOOT_FILES:remove = "ti_logo_414x97_32bpp.bmp.gz"

# Don't include kernels and DTBs in standard images
RRECOMMENDS:${KERNEL_PACKAGE_NAME}-base = ""
MACHINE_ESSENTIAL_EXTRA_RDEPENDS:remove = "kernel-image-image kernel-devicetree"
# Install kernel modules by default
MACHINE_EXTRA_RRECOMMENDS:append = " kernel-modules"

TI_PREFERRED_BSP = "ti-6_6"
PREFERRED_PROVIDER_virtual/kernel = "linux-toradex-ti"
PREFERRED_PROVIDER_virtual/kernel:preempt-rt = "linux-toradex-ti"
PREFERRED_PROVIDER_virtual/dtb = "device-tree-overlays-ti"
PREFERRED_PROVIDER_virtual/bootloader = "u-boot-toradex-ti"
PREFERRED_PROVIDER_u-boot = "u-boot-toradex-ti"

PREFERRED_RPROVIDER_linux-firmware-nxpiw612-sdio = "firmware-nxp-wifi"

KERNEL_DTB_PREFIX = "ti/"
KERNEL_DEVICETREE = " \
    ${KERNEL_DTB_PREFIX}k3-am62p5-verdin-nonwifi-dahlia.dtb \
    ${KERNEL_DTB_PREFIX}k3-am62p5-verdin-nonwifi-dev.dtb \
    ${KERNEL_DTB_PREFIX}k3-am62p5-verdin-nonwifi-ivy.dtb \
    ${KERNEL_DTB_PREFIX}k3-am62p5-verdin-nonwifi-mallow.dtb \
    ${KERNEL_DTB_PREFIX}k3-am62p5-verdin-nonwifi-yavia.dtb \
    ${KERNEL_DTB_PREFIX}k3-am62p5-verdin-wifi-dahlia.dtb \
    ${KERNEL_DTB_PREFIX}k3-am62p5-verdin-wifi-dev.dtb \
    ${KERNEL_DTB_PREFIX}k3-am62p5-verdin-wifi-ivy.dtb \
    ${KERNEL_DTB_PREFIX}k3-am62p5-verdin-wifi-mallow.dtb \
    ${KERNEL_DTB_PREFIX}k3-am62p5-verdin-wifi-yavia.dtb \
"

KERNEL_IMAGETYPE = "Image.gz"
KERNEL_IMAGETYPES = "fitImage Image Image.gz"

# overlays applied by generated overlays.txt
TEZI_EXTERNAL_KERNEL_DEVICETREE_BOOT = "verdin-am62p_dsi-to-hdmi_overlay.dtbo verdin-am62p_spidev_overlay.dtbo"

UBOOT_CONFIG ??= "sd"
UBOOT_CONFIG[sd] = "verdin-am62p_a53_defconfig,sdcard"
UBOOT_ENTRYPOINT = "0x80200000"
UBOOT_LOADADDRESS = "0x80200000"

IMAGE_BOOT_FILES = " \
    boot.scr-${MACHINE};boot.scr \
    ${KERNEL_IMAGETYPE} \
    ${@make_dtb_boot_files(d)} \
"

# meta-ti-bsp/conf/machine/include/k3.inc
# With "sdimage-2part-efi.wks" my builds do not boot, no serial output at
# all
WKS_FILE:k3 = "sdimage-2part.wks"
WKS_FILE_DEPENDS:append = " u-boot-distro-boot"
WIC_CREATE_EXTRA_ARGS:append = " --no-fstab-update"

# handle machine firmware
MACHINE_EXTRA_RRECOMMENDS:append = " linux-firmware-nxpiw612-sdio"
MACHINE_EXTRA_RRECOMMENDS:append = " linux-firmware-powervr"

IMAGE_CLASSES:append = " image_type_tezi"
IMAGE_FSTYPES:append = " teziimg"
# The payload offsets are given in number of 512 byte blocks.
# tiboot3.bin
OFFSET_BOOTROM_PAYLOAD = "0"
FIRMWARE_BINARY[0099] = "tiboot3-am62px-hs-fs-verdin.bin"
# tispl.bin
OFFSET_FW_PAYLOAD = "1024"
# u-boot.img
OFFSET_SPL_PAYLOAD = "5120"
UBOOT_BINARY = "u-boot.img"

TORADEX_PRODUCT_IDS = "0099"
```
